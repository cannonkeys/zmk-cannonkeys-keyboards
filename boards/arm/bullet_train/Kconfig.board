## boards/arm/bullet_train/Kconfig.board
```kconfig
# Copyright (c) 2025 CannonKeys LLC
# SPDX-License-Identifier: MIT

config BOARD_BULLET_TRAIN
    bool "bullet_train"
    depends on SOC_NRF52840_QIAA
```

## boards/arm/bullet_train/Kconfig.defconfig
```kconfig
# Copyright (c) 2025 CannonKeys LLC
# SPDX-License-Identifier: MIT

if BOARD_BULLET_TRAIN

config ZMK_KEYBOARD_NAME
    default "Bullet_Train"

if USB_DEVICE_STACK

config USB_NRFX
    default y

endif # USB_DEVICE_STACK

config BT_CTLR
    default BT

config ZMK_BLE
    default y

config ZMK_USB
    default y

endif # BOARD_BULLET_TRAIN
```

## boards/arm/cerberus/cerberus_defconfig
```kconfig
# Copyright (c) 2024 Andrew Kannan
# SPDX-License-Identifier: MIT

CONFIG_SOC_SERIES_NRF52X=y
CONFIG_SOC_NRF52840_QIAA=y
CONFIG_BOARD_CERBERUS=y

# Enable MPU
CONFIG_ARM_MPU=y

CONFIG_PINCTRL=y

# enable GPIO
CONFIG_GPIO=y

CONFIG_USE_DT_CODE_PARTITION=y
CONFIG_BUILD_OUTPUT_UF2=y

CONFIG_MPU_ALLOW_FLASH_WRITE=y
CONFIG_NVS=y
CONFIG_SETTINGS_NVS=y
CONFIG_FLASH=y
CONFIG_FLASH_PAGE_LAYOUT=y
CONFIG_FLASH_MAP=y

CONFIG_ZMK_RGB_UNDERGLOW=y
CONFIG_WS2812_STRIP=y

CONFIG_ZMK_RGB_UNDERGLOW_HUE_START=160
CONFIG_ZMK_RGB_UNDERGLOW_EFF_START=3
CONFIG_ZMK_RGB_UNDERGLOW_BRT_MIN=10
CONFIG_ZMK_RGB_UNDERGLOW_BRT_MAX=50
CONFIG_ZMK_RGB_UNDERGLOW_AUTO_OFF_IDLE=y

# Enable deep sleep support
CONFIG_ZMK_SLEEP=y

# Status indicator LEDs
CONFIG_RGBLED_WIDGET=y
CONFIG_RGBLED_WIDGET_SHOW_LAYER_COLOR=y
```

## boards/arm/ck60_w/Kconfig.board
```kconfig
# Copyright (c) 2025 Andrew Kannan
# SPDX-License-Identifier: MIT

config BOARD_CK60_W
    bool "ck60_w"
    depends on SOC_NRF52840_QIAA
```

## boards/arm/ck60_w/Kconfig.defconfig
```kconfig
# Copyright (c) 2025 Andrew Kannan
# SPDX-License-Identifier: MIT

if BOARD_CK60_W

config ZMK_KEYBOARD_NAME
    default "CK60 W"

if USB_DEVICE_STACK

config USB_NRFX
    default y

endif # USB_DEVICE_STACK

config BT_CTLR
    default BT

config ZMK_BLE
    default y

config ZMK_USB
    default y

endif # BOARD_CK60_W
```

## boards/arm/ck60_w/ck60_w_defconfig
```kconfig
# Copyright (c) 2023 Andrew Kannan
# SPDX-License-Identifier: MIT

CONFIG_SOC_SERIES_NRF52X=y
CONFIG_SOC_NRF52840_QIAA=y
CONFIG_BOARD_CK60_W=y

# Enable MPU
CONFIG_ARM_MPU=y

CONFIG_PINCTRL=y

# enable GPIO
CONFIG_GPIO=y

CONFIG_USE_DT_CODE_PARTITION=y
CONFIG_BUILD_OUTPUT_UF2=y

CONFIG_MPU_ALLOW_FLASH_WRITE=y
CONFIG_NVS=y
CONFIG_SETTINGS_NVS=y
CONFIG_FLASH=y
CONFIG_FLASH_PAGE_LAYOUT=y
CONFIG_FLASH_MAP=y

CONFIG_ZMK_RGB_UNDERGLOW=y
CONFIG_WS2812_STRIP=y

CONFIG_ZMK_RGB_UNDERGLOW_HUE_START=160
CONFIG_ZMK_RGB_UNDERGLOW_EFF_START=3
CONFIG_ZMK_RGB_UNDERGLOW_BRT_MIN=10
CONFIG_ZMK_RGB_UNDERGLOW_BRT_MAX=50

#Enable deep sleep support
CONFIG_ZMK_SLEEP=y
CONFIG_ZMK_RGB_UNDERGLOW_AUTO_OFF_IDLE=y

# Turn on logging, and set ZMK logging to debug output
# CONFIG_ZMK_USB_LOGGING=y
```

## boards/arm/ck65_w/Kconfig.board
```kconfig
# Copyright (c) 2024 Andrew Kannan
# SPDX-License-Identifier: MIT

config BOARD_CK65_W
    bool "CK65_W"
    depends on SOC_NRF52840_QIAA
```

## boards/arm/ck65_w/Kconfig.defconfig
```kconfig
# Copyright (c) 2024 Andrew Kannan
# SPDX-License-Identifier: MIT

if BOARD_CK65_W

config ZMK_KEYBOARD_NAME
    default "CK65 W"

if USB_DEVICE_STACK

config USB_NRFX
    default y

endif # USB_DEVICE_STACK

config BT_CTLR
    default BT

config ZMK_BLE
    default y

config ZMK_USB
    default y

endif # BOARD_CK65_W
```

## boards/arm/link/Kconfig.board
```kconfig
# Copyright (c) 2025 CannonKeys LLC
# SPDX-License-Identifier: MIT

config BOARD_LINK
    bool "link"
    depends on SOC_NRF52840_QIAA

config BOARD_LINK_LEFT
    bool "link_left"
    depends on SOC_NRF52840_QIAA

config BOARD_LINK_RIGHT
    bool "link_right"
    depends on SOC_NRF52840_QIAA
```

## boards/arm/link/Kconfig.defconfig
```kconfig
# Copyright (c) 2024 CannonKeys LLC
# SPDX-License-Identifier: MIT

if BOARD_LINK_LEFT

config ZMK_KEYBOARD_NAME
    default "Link"

config ZMK_SPLIT_ROLE_CENTRAL
    default y

endif # BOARD_LINK_LEFT

if BOARD_LINK_LEFT || BOARD_LINK_RIGHT

config BOARD
    default "link"

config ZMK_SPLIT
    default y

config BT_CTLR
    default BT

if USB

config USB_NRFX
    default y

config USB_DEVICE_STACK
    default y

endif # USB

endif # BOARD_LINK_LEFT || BOARD_LINK_RIGHT
```

## boards/arm/slp75_v2/Kconfig.defconfig
```kconfig
# Copyright (c) 2024 Andrew Kannan
# SPDX-License-Identifier: MIT

if BOARD_SPLITLP75_LEFT

config ZMK_KEYBOARD_NAME
    default "SplitLP75"

config ZMK_SPLIT_ROLE_CENTRAL
    default y

endif # BOARD_SPLITLP75_LEFT

if BOARD_SPLITLP75_LEFT || BOARD_SPLITLP75_RIGHT

config BOARD
    default "splitlp75"

config ZMK_SPLIT
    default y

config BT_CTLR
    default BT

if USB

config USB_NRFX
    default y

config USB_DEVICE_STACK
    default y

endif # USB

endif # BOARD_SPLITLP75_LEFT || BOARD_SPLITLP75_RIGHT
```

## boards/arm/soleil/Kconfig.board
```kconfig
# Copyright (c) 2020 The ZMK Contributors
# SPDX-License-Identifier: MIT

config BOARD_SOLEIL
	bool "soleil"
	depends on SOC_NRF52840_QIAA
```

## boards/arm/soleil/Kconfig.defconfig
```kconfig
# Copyright (c) 2020 The ZMK Contributors
# SPDX-License-Identifier: MIT

if BOARD_SOLEIL

config BOARD
	default "soleil"

config ZMK_KEYBOARD_NAME
	default "soleil"

if USB_DEVICE_STACK

config USB_NRFX
    default y

endif # USB_DEVICE_STACK

config BT_CTLR
    default y

endif
```

## boards/arm/soleil/soleil_defconfig
```kconfig
# SPDX-License-Identifier: MIT

CONFIG_SOC_SERIES_NRF52X=y
CONFIG_SOC_NRF52840_QIAA=y
CONFIG_BOARD_SOLEIL=y

# Enable MPU
CONFIG_ARM_MPU=y

# Enable GPIO
CONFIG_GPIO=y

CONFIG_USE_DT_CODE_PARTITION=y
CONFIG_BUILD_OUTPUT_UF2=y

CONFIG_MPU_ALLOW_FLASH_WRITE=y
CONFIG_NVS=y
CONFIG_SETTINGS_NVS=y
CONFIG_FLASH=y
CONFIG_FLASH_PAGE_LAYOUT=y
CONFIG_FLASH_MAP=y

CONFIG_PINCTRL=y

CONFIG_ZMK_USB=y
CONFIG_ZMK_BLE=y

CONFIG_ZMK_BLE_EXPERIMENTAL_FEATURES=y
CONFIG_ZMK_BLE_PASSKEY_ENTRY=n

# increase BT power for metal case
CONFIG_BT_CTLR_TX_PWR_PLUS_8=y

# Enable deep sleep
CONFIG_ZMK_SLEEP=y

# Enable soft off
CONFIG_ZMK_PM_SOFT_OFF=y

# Turn on RGB status indicator widget
CONFIG_RGBLED_WIDGET=y
CONFIG_RGBLED_WIDGET_BATTERY_SHOW_SELF=y
```

## boards/arm/splitlp75/Kconfig.board
```kconfig
# Copyright (c) 2024 Andrew Kannan
# SPDX-License-Identifier: MIT

config BOARD_SPLITLP75
    bool "splitlp75"
    depends on SOC_NRF52840_QIAA

config BOARD_SPLITLP75_LEFT
    bool "splitlp75_left"
    depends on SOC_NRF52840_QIAA

config BOARD_SPLITLP75_RIGHT
    bool "splitlp75_right"
    depends on SOC_NRF52840_QIAA
```

## boards/arm/splitlp75/splitlp75_right_defconfig
```kconfig
# Copyright (c) 2024 Andrew Kannan
# SPDX-License-Identifier: MIT

CONFIG_SOC_SERIES_NRF52X=y
CONFIG_SOC_NRF52840_QIAA=y
CONFIG_BOARD_SPLITLP75=y
CONFIG_BOARD_SPLITLP75_RIGHT=y

CONFIG_ZMK_USB=n
CONFIG_ZMK_BLE=y

CONFIG_EC11=y
CONFIG_EC11_TRIGGER_GLOBAL_THREAD=y

# Enable MPU
CONFIG_ARM_MPU=y

CONFIG_PINCTRL=y

# enable GPIO
CONFIG_GPIO=y

CONFIG_USE_DT_CODE_PARTITION=y
CONFIG_BUILD_OUTPUT_UF2=y

CONFIG_MPU_ALLOW_FLASH_WRITE=y
CONFIG_NVS=y
CONFIG_SETTINGS_NVS=y
CONFIG_FLASH=y
CONFIG_FLASH_PAGE_LAYOUT=y
CONFIG_FLASH_MAP=y

CONFIG_ZMK_SLEEP=y

CONFIG_ZMK_RGB_UNDERGLOW=y
CONFIG_WS2812_STRIP=y
CONFIG_ZMK_RGB_UNDERGLOW_HUE_START=160
CONFIG_ZMK_RGB_UNDERGLOW_EFF_START=3
CONFIG_ZMK_RGB_UNDERGLOW_BRT_MIN=10
CONFIG_ZMK_RGB_UNDERGLOW_BRT_MAX=50
```

## config/west.yml
```yaml
manifest:
  remotes:
    - name: zmkfirmware
      url-base: https://github.com/zmkfirmware
    - name: awkannan
      url-base: https://github.com/awkannan
    - name: caksoylar
      url-base: https://github.com/caksoylar
  projects:
    - name: zmk
      remote: awkannan
      revision: develop
      import: app/west.yml
    - name: zmk-gpio-behavior
      remote: awkannan
      revision: main
    - name: zmk-smart-rgbled-widget
      remote: awkannan
      revision: main
    - name: zmk-rgbled-widget
      remote: caksoylar
      revision: main
  self:
    path: config
```
